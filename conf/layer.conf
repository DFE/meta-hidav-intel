## conf/layer.conf
```bitbake
# We have a conf and classes directory, add to BBPATH
BBPATH .= ":${LAYERDIR}"

# We have a packages directory, add to BBFILES
BBFILES += "${LAYERDIR}/recipes*/*/*.bb ${LAYERDIR}/recipes*/*/*.bbappend ${LAYERDIR}/recipes*/*/*.inc"

BBFILE_COLLECTIONS += "meta-hidav-intel"
BBFILE_PATTERN_meta-hidav-intel := "^${LAYERDIR}/"
BBFILE_PRIORITY_meta-hidav-intel = "15"
```
